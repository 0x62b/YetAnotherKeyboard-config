## config/west.yml
```yaml
manifest:
  defaults:
    revision: v0.3
  remotes:
    - name: zmkfirmware
      url-base: https://github.com/zmkfirmware
    - name: YetAnotherKeyboard-config
      url-base: https://github.com/0x62b
  projects:
    - name: zmk
      remote: zmkfirmware
      revision: main
      import: app/west.yml
    - name: YetAnotherKeyboard-config
      remote: YetAnotherKeyboard-config
      revision: main
  self:
    path: config
```
